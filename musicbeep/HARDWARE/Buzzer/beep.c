#include "beep.h"
#include "systick.h"

/*/////////////////////////////////////////////////////////////////////////////////	 
//本程序是BEEP源文件 
作用：唱歌 核心：音调+节拍
1.GPIO初始化
2.存放音调 节拍 播放蜂鸣曲
3.实现程序
（适合STM32F10x系列）		   
引用日期:2018/12/30
All rights reserved
********************************************************************************/
void BEEP_Init(void)
{
	GPIO_InitTypeDef GPIO_InitStructure;
	RCC_APB2PeriphClockCmd( BEEP_PORT_RCC, ENABLE ); 					//1.使能GPIOC时钟
	GPIO_InitStructure.GPIO_Pin = BEEP_PIN;										//2.用到的GPIO口
	GPIO_InitStructure.GPIO_Speed = GPIO_Speed_50MHz;					//3.总线速度
	GPIO_InitStructure.GPIO_Mode = GPIO_Mode_Out_PP;					//4.输出模式=推挽
	GPIO_Init(BEEP_PORT, &GPIO_InitStructure);								//5.GPIO初始化
}

void Sound(u16 frq)
{
	u32 n;
	if(frq != 1000)
	{
		n = 500000/((u32)frq);
		PBeep = 0;
		delay_us(n);
		PBeep = 1;
		delay_us(n);
	}else
		delay_us(1000);
}

void play(void)
{
	//             低7  1   2   3   4   5   6   7  高1 高2 高3 高4 高5 不发音
	uc16 tone[] = {247,262,294,330,349,392,440,294,523,587,659,698,784,1000};//音频数据表
	//红尘情歌
	u8 music[]={	3,6,3,6, 3,6,3,6, 6,13,13,6,//音调               3
								3,6,6,7, 1,1,6,6,6,6,1, 7,5,5,5, 7,6,6,6,6,    //4
							  3,6,6,7, 1,1,6,6,6,6,1, 3,3,3,2,1,1,7,         //3
							1,6,6,6,1, 3,3,2,1, 7,5,5,5,5,7, 2,2,2,2,1,1,7,7,//4

								1,6,6,13,6, 3,6,6,7, 1,1,6,6,6,6,1,            //3
								7,5,5,5, 7,7,6,6,6,6, 3,6,6,7, 1,6,6,6,6,1,    //4
							  3,3,3,2,1,1,7,                                 //1
								1,6,6,6,1, 3,3,2,1, 7,5,5,5,5,7, 2,2,2,2,1,1,7,7,//4
								
							
	};	
	u8 time[] = {	2,2,2,2, 2,2,2,2, 4,4, //节拍                    3
								2,2,2,2, 1,1,1,1,2,1,1, 2,2,2,2, 2,2,2,1,1,    //4
								2,2,2,2, 1,1,1,1,2,1,1, 1,1,1,1,2,1,1,         //3
							2,2,2,1,1, 2,2,2,2, 2,2,1,1,1,1, 1,1,1,1,1,1,1,1,//4 
	
								2,1,1,2,2, 2,2,2,2, 1,1,1,1,2,1,1,             //3
								2,2,2,2, 2,2,2,1,1,    
								2,2,2,2, 1,1,1,1,2,1,1, 1,1,1,1,2,1,1,         
							2,2,2,1,1, 2,2,2,2, 2,2,1,1,1,1, 1,1,1,1,1,1,1,1,
								
	};	

	u32 yanshi;
	u16 i,e;
	yanshi = 10;
	for(i=0;i<sizeof(music)/sizeof(music[0]);i++){
		for(e=0;e<((u16)time[i])*tone[music[i]]/yanshi;e++){
			Sound((u32)tone[music[i]]);
		}	
	}
}
