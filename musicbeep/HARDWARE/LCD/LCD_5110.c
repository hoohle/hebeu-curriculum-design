#include "LCD_5110.h"
#include "systick.h"

//ASCII码编码表
const	unsigned char font5x8[][5]={
    {  0x00, 0x00, 0x00, 0x00, 0x00 },   // sp      00
    {  0x00, 0x00, 0x2f, 0x00, 0x00 },   // !       01
    {  0x00, 0x07, 0x00, 0x07, 0x00 },   // "       02
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    {  0x14, 0x14, 0x14, 0x14, 0x14 }    // horiz lines
};  
  		unsigned char chinese1[]={
0x08,0x78,0xF8,0x88,0x00,0xF8,0xF8,0x88,0x00,0xE8,0x18,0x08,
0x00,0x00,0x0F,0x3F,0x0F,0x01,0x0F,0x3F,0x0E,0x01,0x00,0x00,//W0
0x00,0x00,0x00,0x00,0x80,0x80,0x80,0x80,0x80,0x00,0x00,0x00,
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0x00,0x00,0x33,0x00,0x00,0x00,0x00,0x00,0x00,0x00,0x00,0x00,//: 56
            
};
const	unsigned char bmp[]={
			0x00,0x00,0x00,0x00,0x00,0x00,0x00,0x00,0x00,0x00,0x00,0x00,
      0x00,0x80,0x30,0x88,0xE0,0xFC,0xFC,0xFE,0xFE,0xFE,0xFE,0xFE,
      0xFE,0xEC,0xFC,0xF8,0xF0,0xE0,0x00,0x00,0x00,0x00,0x00,0x00,
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      0x28,0x04,0x3B,0x00,0x20,0x05,0x38,0x0A,0x00,0x00,0x00,0x00,
};
const	unsigned char bmp1[]={
 0x00,0x00,0xFC,0x04,0xF4,0xF4,0xF4,0xF4,0x04,0x04,0xFC,0x00,
 0x98,0xB8,0xC8,0x8C,0x8C,0x00,0x80,0x08,0x08,0x30,0x8C,0x74,
 0x74,0x38,0x00,0x44,0x44,0xFC,0x88,0x18,0x78,0xFC,0x48,0x48,
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 0x11,0x73,0x0D,0x0D,0x6F,0x0E,0x0E,0x0E,0x6F,0x0E,0x0E,0x00,
};
const unsigned char gif[]=
{
      0xFF,0xFF,0xFF,0xFF,0xFF,0xFF,0xFF,0xFF,0xFF,0xFF,0xFF,0xFF,0xFF,0xFF,0xFF,0xFF,0xFF,0xFF,0xFF,0x7F,0x7F,0x7F,0x3F,0x3F,
      0x3F,0x3F,0x1F,0x1F,0x1F,0x1F,0x0F,0x0F,0x0F,0x07,0x07,0x07,0x07,0x03,0x03,0x03,0x03,0x01,0x01,0x01,0x01,0x00,0xFF,0xFF,
      0xFF,0xFF,0xFF,0xFF,0xFF,0xFF,0xFF,0xFF,0xFF,0xFF,0xFF,0xFF,0xFF,0xFF,0xFF,0xFF,0x00,0x00,0x00,0x00,0x80,0x80,0x80,0x80,
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      0xFF,0xFF,0xFF,0xFF,0xFF,0xFF,0xFF,0xFE,0xFC,0xFC,0xF8,0xF8,0xF8,0xF8,0xF8,0xFC,0xFC,0xFE,0xFF,0xFF,0xFF,0xFF,0xFF,0xFF,
};
/*/////////////////////////////////////////////////////////////////////////////////	 
//本程序是LCD液晶显示器源文件 
作用：LCD各种程序		   
引用日期:2018/01/03
All rights reserved
********************************************************************************/

//*********IO口初始化******//
void LCD_IO_init()
{
 
	 GPIO_InitTypeDef  GPIO_InitStructure;
 		
  	GPIO_InitStructure.GPIO_Pin = GPIO_Pin_0 | GPIO_Pin_1| GPIO_Pin_10| GPIO_Pin_11;
  	GPIO_InitStructure.GPIO_Speed = GPIO_Speed_50MHz;
  	GPIO_InitStructure.GPIO_Mode = GPIO_Mode_Out_PP;
  	GPIO_Init(GPIOB , &GPIO_InitStructure);
	
	  GPIO_InitStructure.GPIO_Pin = GPIO_Pin_5;
  	GPIO_InitStructure.GPIO_Speed = GPIO_Speed_50MHz;
  	GPIO_InitStructure.GPIO_Mode = GPIO_Mode_Out_PP;
  	GPIO_Init(GPIOC , &GPIO_InitStructure);
	
	
}

void delay_us_5110(int a)  
{ 
   int ii,bb;    
   //for(ii=0;ii<20;ii++)//32M
   for(ii=0;ii<100;ii++); //64M   
   for(bb=0;bb<a;bb++);   
}

  /**********************************************************************
* 函数名称：LCD_write_byte()
* 函数功能：写一个字节
* 入口参数：data,要写入的字节;command:0为命令,1为数据
* 出口参数：无
* 修改人  ：BDC
* 修改时间：2011/08/04
***********************************************************************/
void LCD_write_byte( unsigned char data, unsigned char command)
{
   unsigned char i;    
  CLR_LCD_CE;    
  if (command == 0)     
   CLR_LCD_DC;	//0
  else    
   SET_LCD_DC;	//1
	for(i=0;i<8;i++)
	{
		if(data&0x80)
			SET_SDIN; //1
		else
			CLR_SDIN; //0
		CLR_SCLK;	  //0
		data= data<< 1;
		SET_SCLK;	 //1
	}   
   SET_LCD_CE;
}

   /**********************************************************************
* 函数名称：LCD_clear()		
* 函数功能：液晶清屏
* 入口参数：无
* 出口参数：无
* 修改人  ：BDC
* 修改时间：2011/08/04
**********************************************************************/
void LCD_clear(void)
  {
    unsigned int i;
    LCD_write_byte(0x0c, 0);			
    LCD_write_byte(0x80, 0);	
    for (i=0; i<504; i++)
      LCD_write_byte(0, 1);			
  }
 
/**********************************************************************
* 函数名称：LCD_Init()		
* 函数功能：初始化nokia5110
* 入口参数：无
* 出口参数：无
* 修改人  ：BDC
* 修改时间：2011/08/04
**********************************************************************/
void LCD_Init(void)
  {           
	LCD_IO_init();

    CLR_LCD_RST; // 产生一个让LCD复位的低电平脉冲
    delay_us_5110(1);
    SET_LCD_RST;
    CLR_LCD_CE;// 关闭LCD  
    delay_us_5110(1);		
    SET_LCD_CE;// 使能LCD
    delay_us_5110(1);
    LCD_write_byte(0x21, 0);	// 使用扩展命令设置LCD模式
    LCD_write_byte(0xbf, 0);	// 设置偏置电压	 b6
    LCD_write_byte(0x06, 0);	// 温度校正
    LCD_write_byte(0x13, 0);	// 1:48
    LCD_write_byte(0x20, 0);	// 使用基本命令
    LCD_clear();	            // 清屏
    LCD_write_byte(0x0c, 0);	// 设定显示模式，正常显示        
    CLR_LCD_CE;               // 关闭LCD  
  }

  /**********************************************************************
* 函数名称：LCD_set_XY()
* 函数功能：光标定位x行y列
* 入口参数：X,Y   x行y列
* 出口参数：无
* 修改人  ：BDC
* 修改时间：2011/08/04
**********************************************************************/
void LCD_set_XY( unsigned char X,  unsigned char Y)
  {
    LCD_write_byte(0x40 | Y, 0);		// column
    LCD_write_byte(0x80 | X, 0);        // row
  }
  
 /***********************************************************************
* 函数名称：LCD_write_char()
* 函数功能：写入1个字符
* 入口参数：c   要写入的数据
* 出口参数：无
* 修改人  ：BDC
* 修改时间：2011/08/04
**********************************************************************/
void LCD_write_char( unsigned char c)
  {
     unsigned char line;
    c -= 32;
    for (line=0; line<5; line++)
      LCD_write_byte(font5x8[c][line], 1);//从ACSII码表中读取字节，然后写入液晶
      LCD_write_byte(0x00, 1);

  }
    
  /***********************************************************************
* 函数名称：LCD_Write_Char()
* 函数功能：写入1个字符
* 入口参数：X:行;Y:列;asc:要写入的数据
* 出口参数：无
* 修改人  ：BDC
* 修改时间：2011/08/04
**********************************************************************/
void LCD_Write_Char( unsigned char X, unsigned char Y, unsigned char asc)
{
   unsigned char line;
  LCD_set_XY(X*6,Y);//光标定位
 // if((asc>=0)&&(asc<=9))
 //   asc = asc+16;
 // else 
    asc = asc-32;
  for (line=0; line<5; line++)
    LCD_write_byte(font5x8[asc][line], 1);//从ACSII码表中读取字节，然后写入液晶
     LCD_write_byte(0x00, 1);

}


/***********************************************************************
* 函数名称：LCD_Write_Num()
* 函数功能：显示变亮
* 入口参数：X:行;Y:列;num:变量;N:要显示的变量的位数
* 出口参数：无
* 修改人  ：BDC
* 修改时间：2011/08/04
**********************************************************************/
/*void LCD_Write_Num( unsigned char X , unsigned char Y ,  int num , unsigned char N)
{  
   unsigned char line;
   unsigned char i=0;
   unsigned int n[5]={0};
    if ( num <0 )
    {
    
        num= -num;
        LCD_Write_Char(X, Y , '-');
       X=X+1;  
       n[0]= num%10;
       n[1]=(num/10)%10;
       n[2]=(num/100)%10;
       n[3]=(num/1000)%10;
       n[4]=(num/10000)%10;
      //for(i=0;i<5;i++) n[i]=n[i]+16;
       
       for(i=N;i>0;i--) 
       {
       
       
          LCD_Write_Char(X+N-i, Y , n[i-1]+48);
          
          
         // LCD_set_XY((X+(N-i))*6,Y);//光标定位
         // for (line=0; line<5; line++)
          //LCD_write_byte(font5x8[n[i-1]][line], 1);//从ACSII码表中读取字节，然后写入液晶
         // LCD_write_byte(0x00, 1);

      }
      
    } 
    
    else
    
    {
      //	  LCD_Write_Char(X, Y , '+');
		     X=X+1;
          n[0]= num%10;
          n[1]=(num/10)%10;
          n[2]=(num/100)%10;
          n[3]=(num/1000)%10;
          n[4]=(num/10000)%10;
          for(i=0;i<5;i++) n[i]=n[i]+16;
          for(i=N;i>0;i--) 
          {
            LCD_set_XY((X+(N-i))*6,Y);//光标定位
            
            for (line=0; line<5; line++)
              LCD_write_byte(font5x8[n[i-1]][line], 1);//从ACSII码表中读取字节，然后写入液晶
              LCD_write_byte(0x00, 1);

      }
    }
}
*/


void LCD_Write_Num( unsigned char X , unsigned char Y ,  int num , unsigned char N)
{  
   unsigned char line;
   unsigned char i=0;
   unsigned int n[7]={0};
    if ( num <0 )
    {
    
        num= -num;
        LCD_Write_Char(X, Y , '-');
       X=X+1;  
       n[0]= num%10;
       n[1]=(num/10)%10;
       n[2]=(num/100)%10;
       n[3]=(num/1000)%10;
       n[4]=(num/10000)%10;
			 n[5]=(num/100000)%10;
       n[6]=(num/1000000)%10;
       for(i=N;i>0;i--) 
       {
       
       
          LCD_Write_Char(X+N-i, Y , n[i-1]+48);
          
          
         // LCD_set_XY((X+(N-i))*6,Y);//光标定位
         // for (line=0; line<5; line++)
          //LCD_write_byte(font5x8[n[i-1]][line], 1);//从ACSII码表中读取字节，然后写入液晶
         // LCD_write_byte(0x00, 1);

      }
      
    } 
    
    else
    
    {
      //	  LCD_Write_Char(X, Y , '+');
		     X=X+1;
          n[0]= num%10;
          n[1]=(num/10)%10;
          n[2]=(num/100)%10;
          n[3]=(num/1000)%10;
          n[4]=(num/10000)%10;
			 n[5]=(num/100000)%10;
       n[6]=(num/1000000)%10;
          for(i=0;i<7;i++) n[i]=n[i]+16;
          for(i=N;i>0;i--) 
          {
            LCD_set_XY((X+(N-i))*6,Y);//光标定位
            
            for (line=0; line<5; line++)
              LCD_write_byte(font5x8[n[i-1]][line], 1);//从ACSII码表中读取字节，然后写入液晶
              LCD_write_byte(0x00, 1);

      }
    }
}







/***********************************************************************
* 函数名称LCD_write_english_string()
* 函数功能：写英文字符串
* 入口参数：X,Y,*S------x行y列*s为英文字符串
* 出口参数：无
* 修改人  ：BDC
* 修改时间：2011/08/04
***********************************************************************/
void LCD_write_english_string( unsigned char X, unsigned char Y,unsigned char *s)
  {
  	int n=0;
    LCD_set_XY(X*6,Y);//光标定位
	n=n+X;
    while (*s) 
    {
  	 LCD_write_char(*s);
  	 s++;
	 n++;
    }
	//清空到本行末尾
	while(n<14)
	{
		LCD_write_char(0x00);
		n++;	
	}
  }

 

/*********************************************************** 
*函数名称：LCD_vertical_bar
*函数功能：画竖线
*入口参数：X ：位图绘制的起始X。vertical_bar竖线内容
*
*出口参数：无 
*修改人  ：
*修改时间：
*备 注： 
***********************************************************/

void LCD_vertical_bar(unsigned char X ,  unsigned char *vertical_bar)

{
     char vertical_num;
    LCD_write_byte(0x22, 0);	// 使用基本命令     PD=0；   V=1 竖直；  H=0基本指令集 
    LCD_set_XY(X,0);
    for(vertical_num=0;vertical_num<6;vertical_num++) 
    {
     LCD_write_byte (*(vertical_bar+vertical_num),1);
    }
    LCD_write_byte(0x20, 0);//正常显示

}


/*********************************************************** 
*函数名称：LCD_Vertical_Bar
*函数功能：画竖线  动态
*入口参数:   X:横坐标；high:需要的高度
*
*出口参数：无 
*修改人  ：
*修改时间：
*备 注： 
**********************************************************
void LCD_Vertical_Bar(unsigned char X,unsigned char high )
{
                char quotient , remainder , i=5 ; //商，余数
                unsigned char v_bar[6]={0,0,0,0,0,0} ;

                quotient = high/8; 
                remainder = high%8;
                
                for ( ; quotient > 0 ; quotient -- )
                
                {
                    v_bar[i] = 0xff;             //下面的填黑色
                     i-- ;
                
                }
                
               switch(remainder)        //选择白黑分界时的高低
               
               {
                case 1 : v_bar[i]=0x80 ; break;
                case 2 : v_bar[i]=0xc0 ; break;
                case 3 : v_bar[i]=0xe0 ; break;
                case 4 : v_bar[i]=0xf0 ; break;
                case 5 : v_bar[i]=0xf8 ; break;
                case 6 : v_bar[i]=0xfc ; break;
                case 7 : v_bar[i]=0xfe ; break;
                
               }
               
               i--;
               
               for (  ; i >= 0 ;  i -- )
               
               {
               
                     v_bar[i] = 0x00;             //上面填白色

               }
               
              LCD_vertical_bar( X , v_bar );  

}

   */

//****************************************************************************************************
// 写一个汉字
//****************************************************************************************************
void LCD_Write_cn(unsigned char row, unsigned char page,unsigned char c) //row:列 page:页 dd:字符
{
	unsigned char i;  	
	
	LCD_set_XY( row,page);// 列，页 
	for(i=0; i<12;i++) 
	{
		LCD_write_byte(chinese1[c*24+i],1); 		
	}

    LCD_set_XY(row, page+1);// 列，页 
	for(i=12; i<24;i++) 
	{
		LCD_write_byte(chinese1[c*24+i],1);
	}	
	
}

/************************************************************************************************/
//注意的是由于一个汉字占两行，所以液晶上最多显示三行汉字或者六行英文
//一行最多占7个汉字，此时字间距为12
/***************************************写一组汉字***************************************************/
void LCD_Write_words(unsigned char row,unsigned char page,unsigned char n,unsigned char c,unsigned word_spacing)  //n 代表写几个字，row，列，page，页，c 代表从字库表的第几个开始,word_spacing代表字间距，推荐为14
{
	  unsigned char i,num;  //num是一个判断数字 	
	  for(num=0;num<n;num++)
		{
			LCD_set_XY( row+word_spacing*num,page);// 列，页 
		  for(i=0; i<12;i++) 
				{
					LCD_write_byte(chinese1[(c+num)*24+i],1); 	  //写入数据	,先写前12个
				}

					LCD_set_XY(row+word_spacing*num, page+1);// 列，页 
				for(i=12; i<24;i++)                      //写入后12个
				{
					LCD_write_byte(chinese1[(c+num)*24+i],1);
				}	
		
		
		}
}


/***********************************************************
函数名称：LCD_draw_bmp_pixel
函数功能：位图绘制函数
入口参数：X、Y    ：位图绘制的起始X、Y坐标；
          *map    ：位图点阵数据；
          Pix_x   ：位图像素（长）
          Pix_y   ：位图像素（宽）
出口参数：无
备 注：
***********************************************************/
void LCD_draw_bmp_pixel(unsigned char X,unsigned char Y,unsigned char *map, unsigned char Pix_x,unsigned char Pix_y)
{
    unsigned int i,n;
    unsigned char row;
                                            //计算位图所占行数
      if (Pix_y%8==0)             //如果为位图所占行数为整数
           row=Pix_y/8;     
      else
         row=Pix_y/8+1;            //如果为位图所占行数不是整数
   
      LCD_set_XY(X,Y);
    for (n=0;n<row;n++)            //换行
      {     
        for(i=0;i<Pix_x;i++)
          {     
                 LCD_set_XY(X+i,Y+n);
             LCD_write_byte(bmp[i+n*Pix_x], 1);
          }                        
      }     
}

void LCD_draw_bmp_pause(unsigned char X,unsigned char Y,unsigned char *map, unsigned char Pix_x,unsigned char Pix_y)
{
    unsigned int i,n;
    unsigned char row;
                                            //计算位图所占行数
      if (Pix_y%8==0)             					//如果为位图所占行数为整数
           row=Pix_y/8;     
      else
         row=Pix_y/8+1;            					//如果为位图所占行数不是整数
   
      LCD_set_XY(X,Y);
    for (n=0;n<row;n++)            					//换行
      {     
        for(i=0;i<Pix_x;i++)
          {     
                 LCD_set_XY(X+i,Y+n);
             LCD_write_byte(bmp1[i+n*Pix_x], 1);
          }                        
      }     
}

void LCD_draw_bmp_full(unsigned char X,unsigned char Y, unsigned char *img,unsigned char Pix_x,unsigned char Pix_y)			//隐藏歌曲充数画图程序
{
		
	   unsigned int i,n;
    unsigned char row;
                                            //计算位图所占行数
      if (Pix_y%8==0)             					//如果为位图所占行数为整数
           row=Pix_y/8;     
      else
         row=Pix_y/8+1;            					//如果为位图所占行数不是整数
   
      LCD_set_XY(X,Y);
    for (n=0;n<row;n++)            					//换行
      {     
        for(i=0;i<Pix_x;i++)
          {     
                 LCD_set_XY(X+i,Y+n);
             LCD_write_byte(gif[i+n*Pix_x], 1);
          }                        
      }     
}

/*******************************开机液晶显示程序*************************************************/
void LCD_Start(void)
{
						LCD_clear();                                     //液晶清屏
						LCD_Write_words(0,0,7,0,12);                     //Welcome    0--6		
						LCD_Write_words(6,4,6,7,12);                     //要来点音乐么  7-12
						delay_ms(1000);
					  LCD_clear();
						LCD_Write_words(0,2,7,13,12);										 //通信1621
						delay_ms(700);
						LCD_clear();
}

/***********************************曲目名显示程序*************************************************/
void LCD_ID(char n)
{
	switch(n){
		case 0:			
			LCD_clear();
		Display_num(1);																									//数码管显示对应曲目号
		LCD_Write_words(5,0,4,53,14);
			LCD_Write_words(5,4,5,20,14);																	//显示1生日快乐
		break;
		
		case 1:
			LCD_clear();
		Display_num(2);
				LCD_Write_words(5,0,4,53,14);
			LCD_Write_words(8,4,4,25,14);																	//显示2茉莉花
		break;
		
		case 2:
			LCD_clear();
		Display_num(3);
				LCD_Write_words(5,0,4,53,14);
			LCD_Write_words(0,4,6,29,14);																	//显示3铃儿响叮当
		break;
		
		case 3:
			LCD_clear();
		Display_num(4);
				LCD_Write_words(5,0,4,53,14);
			LCD_Write_words(5,4,5,35,14);    															//显示4天空之城
		break;
		
		case 4:
			LCD_clear();
		Display_num(5);
				LCD_Write_words(5,0,4,53,14);
			LCD_Write_words(5,4,6,40,14);    															//显示5最炫民族风
		break;
		/****拓展曲目*****/		
		case 5:	LCD_clear(); Display_num(6); LCD_draw_bmp_full(20,0,0,48,48);break;											//第六首
		case 6:	LCD_clear(); Display_num(7); LCD_draw_bmp_full(20,0,0,48,48);break;											//第七首
		case 7: LCD_clear(); Display_num(8); LCD_draw_bmp_full(20,0,0,48,48);break;											//第八首
			
		
		
	}
}
